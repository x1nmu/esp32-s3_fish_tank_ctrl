## firmware/esp32_idf/sdkconfig.defaults
```kconfig
CONFIG_ESP_TASK_WDT_INIT=n
CONFIG_I2C_SUPPRESS_DEPRECATE_WARN=y
CONFIG_ESPTOOLPY_FLASHSIZE_16MB=y
CONFIG_ESPTOOLPY_FLASHSIZE="16MB"
CONFIG_SPIRAM=y
CONFIG_SPIRAM_MODE_OCT=y
CONFIG_SPIRAM_IGNORE_NOTFOUND=y
CONFIG_PARTITION_TABLE_CUSTOM=y
CONFIG_PARTITION_TABLE_CUSTOM_FILENAME="partitions.csv"
CONFIG_PARTITION_TABLE_FILENAME="partitions.csv"
# CONFIG_DEBUG_FLASH_PSRAM_ENABLE is not set
```
